## sdkconfig.defaults
```kconfig
CONFIG_IDF_TARGET="esp32s3"

# TinyUSB 設定
CONFIG_TINYUSB_ENABLED=y
CONFIG_TINYUSB_HID_COUNT=1

# Bluetooth (NimBLE) 設定
CONFIG_BT_ENABLED=y
CONFIG_BT_NIMBLE_ENABLED=y
CONFIG_BT_NIMBLE_MAX_CONNECTIONS=1
CONFIG_BT_NIMBLE_ATT_PREFERRED_MTU=256
CONFIG_BT_NIMBLE_HOST_TASK_STACK_SIZE=6144
CONFIG_BT_NIMBLE_SM_LEGACY=y
CONFIG_BT_NIMBLE_SM_SC=y
CONFIG_BT_NIMBLE_NVS_PERSIST=y
CONFIG_BT_NIMBLE_MAX_BONDS=3
```
